## sdkconfig.defaults
```kconfig
CONFIG_BOOTLOADER_APP_ROLLBACK_ENABLE=y
CONFIG_AUTOSTART_ARDUINO=n
CONFIG_PARTITION_TABLE_CUSTOM=y
CONFIG_PARTITION_TABLE_CUSTOM_FILENAME="partitions.csv"
CONFIG_PARTITION_TABLE_FILENAME="partitions.csv"
CONFIG_FREERTOS_HZ=1000
CONFIG_ESPTOOLPY_FLASHSIZE_8MB=y
CONFIG_APP_REPRODUCIBLE_BUILD=y
```
